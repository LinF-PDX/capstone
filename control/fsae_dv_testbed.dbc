VERSION ""

NS_ :

BS_:

BU_: ECU LAPTOP

BO_ 512 DV_Command: 8 LAPTOP
 SG_ TargetSteeringAngle : 0|16@1- (0.1,0) [-3276.8|3276.7] "deg" ECU
 SG_ TargetMotorSpeed : 16|16@1+ (1,0) [0|1000] "pwm" ECU

BO_ 513 DV_Feedback: 8 ECU
 SG_ EncoderCount : 0|32@1+ (1,0) [0|4294967295] "counts" LAPTOP

BA_DEF_  "BusType" STRING ;
BA_DEF_DEF_  "BusType" "CAN";
